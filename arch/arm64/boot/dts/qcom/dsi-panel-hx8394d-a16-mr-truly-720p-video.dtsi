/* Copyright (c) 2014-2016, The Linux Foundation. All rights reserved.
 * Copyright (c) 2026, LineageOS Project.
 *
 * This program is free software; you can redistribute it and/or modify
 * it under the terms of the GNU General Public License version 2 and
 * only version 2 as published by the Free Software Foundation.
 *
 * This program is distributed in the hope that it will be useful,
 * but WITHOUT ANY WARRANTY; without even the implied warranty of
 * MERCHANTABILITY or FITNESS FOR A PARTICULAR PURPOSE.  See the
 * GNU General Public License for more details.
 */

&mdss_mdp {
	dsi_hx8394d_a16_mr_truly_720_vid: qcom,mdss_dsi_a16_mr_truly_hx8394d_720p_video {
		qcom,mdss-dsi-panel-name = "a16 mr truly hx8394d 720p video mode dsi panel";
		qcom,mdss-dsi-panel-controller = <&mdss_dsi0>;
		qcom,mdss-dsi-panel-type = "dsi_video_mode";
		qcom,mdss-dsi-panel-destination = "display_1";
		qcom,mdss-dsi-panel-framerate = <0x35>;
		qcom,mdss-dsi-virtual-channel-id = <0x00>;
		qcom,mdss-dsi-stream = <0x00>;
		qcom,mdss-dsi-panel-width = <0x2d0>;
		qcom,mdss-dsi-panel-height = <0x500>;
		qcom,mdss-dsi-h-front-porch = <0x64>;
		qcom,mdss-dsi-h-back-porch = <0x4e>;
		qcom,mdss-dsi-h-pulse-width = <0x60>;
		qcom,mdss-dsi-h-sync-skew = <0x00>;
		qcom,mdss-dsi-v-back-porch = <0x10>;
		qcom,mdss-dsi-v-front-porch = <0x09>;
		qcom,mdss-dsi-v-pulse-width = <0x02>;
		qcom,mdss-dsi-h-left-border = <0x00>;
		qcom,mdss-dsi-h-right-border = <0x00>;
		qcom,mdss-dsi-v-top-border = <0x00>;
		qcom,mdss-dsi-v-bottom-border = <0x00>;
		qcom,mdss-dsi-bpp = <0x18>;
		qcom,mdss-dsi-color-order = "rgb_swap_rgb";
		qcom,mdss-dsi-underflow-color = <0x00>;
		qcom,mdss-dsi-border-color = <0x00>;
		qcom,mdss-dsi-on-command = [39 01 00 00 00 00 04 b9 ff 83 94 39 01 00 00 00 00 03 ba 72 83 39 01 00 00 00 00 10 b1 6c 55 15 11 04 11 f1 80 e8 95 23 80 c0 d2 58 39 01 00 00 00 00 0c b2 00 64 10 07 32 1c 08 08 1c 4d 00 15 01 00 00 00 00 02 bc 07 39 01 00 00 00 00 0d b4 00 ff 03 5c 03 5c 03 5c 01 70 01 70 39 01 00 00 00 00 02 d2 55 39 01 00 00 00 00 1f d3 00 0f 00 01 1a 08 00 32 10 08 00 08 54 15 0f 05 04 02 12 10 05 07 23 22 0c 0c 27 10 07 07 39 01 00 00 00 00 2d d5 19 19 18 18 1b 1b 1a 1a 04 05 06 07 00 01 02 03 20 21 18 18 22 23 18 18 18 18 18 18 18 18 18 18 18 18 18 18 18 18 18 18 18 18 18 18 39 01 00 00 00 00 2d d6 18 18 19 19 1b 1b 1a 1a 03 02 01 00 07 06 05 04 23 22 18 18 21 20 18 18 18 18 18 18 18 18 18 18 18 18 18 18 18 18 18 18 18 18 18 18 39 01 00 00 00 00 2b e0 00 03 09 23 27 3f 1c 3a 06 0a 0b 17 0d 10 12 11 13 07 11 14 18 00 03 09 23 29 3f 1c 3a 06 0a 0b 17 0e 11 12 11 13 07 12 13 18 39 01 00 00 00 00 03 c0 30 14 39 01 00 00 00 00 05 c7 00 c0 00 c0 15 01 00 00 00 00 02 cc 09 39 01 00 00 00 00 02 df 87 39 01 00 00 00 00 02 c6 bd 39 01 00 00 00 00 02 bd 02 39 01 00 00 00 00 0d d8 ff ff ef be aa a0 ff ff ef be aa a0 39 01 00 00 00 00 02 bd 00 15 01 00 00 00 00 02 51 ff 15 01 00 00 00 00 02 53 24 39 01 00 00 00 00 08 c9 1f 00 14 1e 81 1e 00 15 01 00 00 05 00 02 55 01 15 01 00 00 00 00 02 5e 00 39 01 00 00 00 00 0a ca 40 30 2f 2e 2d 26 23 21 20 39 01 00 00 00 00 23 ce 00 00 00 10 10 10 10 20 20 20 20 20 20 20 30 30 30 30 30 30 30 30 30 30 30 30 30 30 30 30 30 30 30 00 39 01 00 00 0a 00 03 e4 d3 00 39 01 00 00 00 00 2c e5 00 08 0e 0a 09 00 20 20 20 10 00 00 00 00 00 00 80 0a 20 08 09 0a 0e 0b 0b 0a 0a 09 08 05 03 00 00 00 00 00 00 00 00 00 00 00 00 39 01 00 00 05 00 12 e6 00 00 00 05 05 1c 18 1c 20 20 20 16 12 16 1c 20 20 15 01 00 00 78 00 02 11 00 05 01 00 00 0a 00 02 29 00];
		qcom,mdss-dsi-off-command = [05 01 00 00 0a 00 02 28 00 05 01 00 00 28 00 02 10 00];
		qcom,mdss-dsi-on-command-state = "dsi_lp_mode";
		qcom,mdss-dsi-off-command-state = "dsi_hs_mode";
		qcom,mdss-dsi-h-sync-pulse = <0x00>;
		qcom,mdss-dsi-traffic-mode = "non_burst_sync_event";
		qcom,mdss-dsi-bllp-eof-power-mode;
		qcom,mdss-dsi-lane-map = "lane_map_0123";
		qcom,mdss-dsi-bllp-power-mode;
		qcom,mdss-dsi-lane-0-state;
		qcom,mdss-dsi-lane-1-state;
		qcom,mdss-dsi-lane-2-state;
		qcom,mdss-dsi-panel-timings = <0x382f2500 0x433d2a31 0x3c030400>;
		qcom,mdss-dsi-t-clk-post = <0x1f>;
		qcom,mdss-dsi-t-clk-pre = <0x39>;
		qcom,mdss-dsi-bl-min-level = <1>;
		qcom,mdss-dsi-bl-max-level = <0xff>;
		qcom,mdss-dsi-dma-trigger = "trigger_sw";
		qcom,mdss-dsi-mdp-trigger = "none";

		qcom,cont-splash-enabled;
		qcom,mdss-first-power-on-handoff;
		qcom,mdss-dsi-bl-pmic-control-type = "bl_ctrl_wled";
		qcom,mdss-dsi-default-command-state = "dsi_hs_mode";
		qcom,mdss-pan-physical-width-dimension = <0x3e>;
		qcom,mdss-pan-physical-height-dimension = <0x6e>;
		qcom,mdss-dsi-lp11-init;
		qcom,panel-supply-entries = <&dsi_panel_pwr_supply>;
		qcom,mdss-dsi-reset-sequence = <1 20>, <0 1>, <1 20>;
	};

};
