/* Copyright (c) 2014-2015, 2020, The Linux Foundation. All rights reserved.
 *
 * This program is free software; you can redistribute it and/or modify
 * it under the terms of the GNU General Public License version 2 and
 * only version 2 as published by the Free Software Foundation.
 *
 * This program is distributed in the hope that it will be useful,
 * but WITHOUT ANY WARRANTY; without even the implied warranty of
 * MERCHANTABILITY or FITNESS FOR A PARTICULAR PURPOSE.  See the
 * GNU General Public License for more details.
 */

&mdss_mdp {
	dsi_boent35523_800p_vid: qcom,mdss_dsi_boent35523_800p_video {
		qcom,mdss-dsi-panel-name = "boeNT35523 800p video mode dsi panel";
		qcom,mdss-dsi-panel-controller = <&mdss_dsi0>;
		qcom,mdss-dsi-panel-type = "dsi_video_mode";
		qcom,mdss-dsi-panel-destination = "display_1";
		qcom,mdss-dsi-panel-framerate = <60>;
		qcom,mdss-dsi-virtual-channel-id = <0>;
		qcom,mdss-dsi-stream = <0>;
		qcom,mdss-dsi-panel-width = <800>;
		qcom,mdss-dsi-panel-height = <1280>;
		qcom,mdss-dsi-h-front-porch = <50>;
		qcom,mdss-dsi-h-back-porch = <50>;
		qcom,mdss-dsi-h-pulse-width = <2>;
		qcom,mdss-dsi-h-sync-skew = <0>;
		qcom,mdss-dsi-v-back-porch = <16>;
		qcom,mdss-dsi-v-front-porch = <8>;
		qcom,mdss-dsi-v-pulse-width = <2>;
		qcom,mdss-dsi-h-left-border = <0>;
		qcom,mdss-dsi-h-right-border = <0>;
		qcom,mdss-dsi-v-top-border = <0>;
		qcom,mdss-dsi-v-bottom-border = <0>;
		qcom,mdss-dsi-bpp = <24>;
		qcom,mdss-dsi-underflow-color = <0x0>;
		qcom,mdss-dsi-border-color = <0>;
		qcom,mdss-dsi-on-command = <0x39010000 0x6f0 0x55aa5208 0x1390100 0x02 0xce043901 0x00 0x3bc6801 0x39010000 0x3bd 0x68013901 0x00 0x5ffaa55 0xa5803901 0x00 0x26f0939 0x1000000 0x2f782 0x39010000 0x26f 0xb390100 0x02 0xf7e00501 0x7800 0x2110005 0x100000a 0x22900>;
		qcom,mdss-dsi-off-command = [05 01 00 00 14 00 02 28 00 05 01 00 00 78 00 02 10 00];
		warm-command = [39 01 00 00 00 00 06 f0 55 aa 52 08 02 39 01 00 00 00 00 02 b0 c0 39 00 00 00 00 00 11 d1 00 01 00 12 00 32 00 4d 00 62 00 88 00 a7 00 db 39 00 00 00 00 00 11 d2 01 04 01 46 01 71 01 c8 02 0e 02 0f 02 4e 02 92 39 00 00 00 00 00 11 d3 02 bd 02 f5 03 1c 03 48 03 6c 03 96 03 af 03 c2 39 01 00 00 00 00 05 d4 03 f8 03 ff 39 00 00 00 00 00 11 d5 00 c6 00 cd 00 d7 00 e1 00 eb 00 fd 01 0f 01 30 39 00 00 00 00 00 11 d6 01 4b 01 7c 01 a5 01 e9 02 24 02 26 02 5d 02 9e 39 00 00 00 00 00 11 d7 02 c8 03 01 03 28 03 5b 03 7c 03 a3 03 bd 03 d8 39 01 00 00 00 00 05 d8 03 f5 03 ff 39 00 00 00 00 00 11 d9 01 3e 01 41 01 47 01 4d 01 52 01 5d 01 68 01 7e 39 00 00 00 00 00 11 dd 01 90 01 b2 01 d2 02 0a 02 3d 02 3f 02 71 02 b1 39 00 00 00 00 00 11 de 02 dc 03 19 03 47 03 93 03 c0 03 cd 03 d2 03 e3 39 01 00 00 00 00 05 df 03 fb 03 ff];
		default-command = [39 01 00 00 00 00 06 f0 55 aa 52 08 02 39 01 00 00 00 00 02 b0 c0 39 00 00 00 00 00 11 d1 00 01 00 12 00 32 00 4d 00 62 00 88 00 a7 00 db 39 00 00 00 00 00 11 d2 01 04 01 46 01 71 01 c8 02 0e 02 0f 02 4f 02 92 39 00 00 00 00 00 11 d3 02 be 02 f7 03 1f 03 51 03 71 03 96 03 af 03 c2 39 01 00 00 00 00 05 d4 03 f9 03 ff 39 00 00 00 00 00 11 d5 00 01 00 12 00 31 00 4a 00 60 00 85 00 a4 00 d7 39 00 00 00 00 00 11 d6 01 00 01 44 01 7a 01 cc 02 10 02 11 02 4f 02 91 39 00 00 00 00 00 11 d7 02 bc 02 f6 03 1e 03 51 03 73 03 9e 03 b5 03 dd 39 01 00 00 00 00 05 d8 03 f5 03 ff 39 00 00 00 00 00 11 d9 00 15 00 24 00 3f 00 55 00 69 00 8d 00 aa 00 db 39 00 00 00 00 00 11 dd 01 03 01 45 01 78 01 cc 02 10 02 11 02 50 02 92 39 00 00 00 00 00 11 de 02 be 02 fa 03 23 03 60 03 93 03 c8 03 cd 03 e3 39 01 00 00 00 00 05 df 03 fd 03 ff];
		cold-command = [39 01 00 00 00 00 06 f0 55 aa 52 08 02 39 01 00 00 00 00 02 b0 c0 39 00 00 00 00 00 11 d1 00 be 00 c4 00 d0 00 dc 00 e6 00 f9 01 0c 01 2a 39 00 00 00 00 00 11 d2 01 47 01 72 01 9e 01 e8 02 25 02 27 02 5e 02 9f 39 00 00 00 00 00 11 d3 02 c8 03 04 03 29 03 5b 03 71 03 96 03 af 03 c2 39 01 00 00 00 00 05 d4 03 f9 03 ff 39 00 00 00 00 00 11 d5 00 f4 00 f9 01 01 01 09 01 11 01 20 01 2f 01 49 39 00 00 00 00 00 11 d6 01 61 01 8e 01 b3 01 f2 02 2b 02 2d 02 62 02 a2 39 00 00 00 00 00 11 d7 02 cd 03 06 03 2d 03 5f 03 73 03 9e 03 b5 03 d7 39 01 00 00 00 00 05 d8 03 f5 03 ff 39 00 00 00 00 00 11 d9 00 01 00 0f 00 29 00 40 00 53 00 75 00 95 00 c6 39 00 00 00 00 00 11 dd 00 f1 01 34 01 6d 01 c5 02 0d 02 0f 02 4b 02 90 39 00 00 00 00 00 11 de 02 ba 02 f7 03 1e 03 55 03 8e 03 c8 03 cd 03 f4 39 01 00 00 00 00 05 df 03 fd 03 ff];
		qcom,mdss-dsi-on-command-state = "dsi_lp_mode";
		qcom,mdss-dsi-off-command-state = "dsi_lp_mode";
		qcom,mdss-extra-command-state = "dsi_hs_mode";
		qcom,cont-splash-enabled;
		qcom,mdss-dsi-h-sync-pulse = <1>;
		qcom,mdss-dsi-traffic-mode = "burst_mode";
		qcom,mdss-dsi-bllp-eof-power-mode;
		qcom,mdss-dsi-bllp-power-mode;
		qcom,mdss-dsi-lane-0-state;
		qcom,mdss-dsi-lane-1-state;
		qcom,mdss-dsi-lane-2-state;
		qcom,mdss-dsi-lane-3-state;
		qcom,mdss-dsi-panel-timings = <0x7a1a1200 0x3e42161e 0x14030400>;
		qcom,mdss-dsi-t-clk-post = <0x04>;
		qcom,mdss-dsi-t-clk-pre = <0x1b>;
		qcom,mdss-dsi-bl-min-level = <1>;
		qcom,mdss-dsi-bl-max-level = <4095>;
		qcom,mdss-dsi-dma-trigger = "trigger_sw";
		qcom,mdss-dsi-mdp-trigger = "none";
		qcom,mdss-dsi-bl-pmic-control-type = "bl_ctrl_pwm";
		qcom,platform-bklight-en-gpio = <&msm_gpio 9 0>;
		qcom,mdss-dsi-lcden-ctrl = <&msm_gpio 24 0>;
		qcom,mdss-dsi-bl-pmic-pwm-frequency = <100>;
		qcom,mdss-dsi-bl-pmic-bank-select = <0>;
		qcom,mdss-dsi-pwm-gpio = <&pm8909_mpps 2 0>;
		qcom,mdss-dsi-reset-sequence = <1 20>, <0 10>, <1 120>;
		qcom,mdss-pan-physical-width-dimension = <108>;
		qcom,mdss-pan-physical-height-dimension = <172>;
		qcom,mdss-white-point = <27017 29141 25714>;
	};
};
