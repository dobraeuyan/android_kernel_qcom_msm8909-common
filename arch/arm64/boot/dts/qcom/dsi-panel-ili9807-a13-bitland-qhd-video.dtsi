/* Copyright (c) 2014-2016, The Linux Foundation. All rights reserved.
 * Copyright (c) 2026, LineageOS Project.
 *
 * This program is free software; you can redistribute it and/or modify
 * it under the terms of the GNU General Public License version 2 and
 * only version 2 as published by the Free Software Foundation.
 *
 * This program is distributed in the hope that it will be useful,
 * but WITHOUT ANY WARRANTY; without even the implied warranty of
 * MERCHANTABILITY or FITNESS FOR A PARTICULAR PURPOSE.  See the
 * GNU General Public License for more details.
 */

&mdss_mdp {
	dsi_ili9807_a13_bitland_qhd_vid: qcom,mdss_dsi_a13_bitland_ili9807_qhd_video {
		qcom,mdss-dsi-panel-name = "bitland ili9807 qhd video mode dsi panel";
		qcom,mdss-dsi-panel-controller = <&mdss_dsi0>;
		qcom,mdss-dsi-panel-type = "dsi_video_mode";
		qcom,mdss-dsi-panel-destination = "display_1";
		qcom,mdss-dsi-panel-framerate = <0x39>;
		qcom,mdss-dsi-virtual-channel-id = <0x00>;
		qcom,mdss-dsi-stream = <0x00>;
		qcom,mdss-dsi-panel-width = <0x21c>;
		qcom,mdss-dsi-panel-height = <0x3c0>;
		qcom,mdss-dsi-h-front-porch = <0x32>;
		qcom,mdss-dsi-h-back-porch = <0x44>;
		qcom,mdss-dsi-h-pulse-width = <0x2d>;
		qcom,mdss-dsi-h-sync-skew = <0x00>;
		qcom,mdss-dsi-v-front-porch = <0x0e>;
		qcom,mdss-dsi-v-back-porch = <0x14>;
		qcom,mdss-dsi-v-pulse-width = <0x06>;
		qcom,mdss-dsi-h-left-border = <0x00>;
		qcom,mdss-dsi-h-right-border = <0x00>;
		qcom,mdss-dsi-v-top-border = <0x00>;
		qcom,mdss-dsi-v-bottom-border = <0x00>;
		qcom,mdss-dsi-bpp = <0x18>;
		qcom,mdss-dsi-color-order = <0x00>;
		qcom,mdss-dsi-underflow-color = <0x00>;
		qcom,mdss-dsi-border-color = <0x00>;
		qcom,mdss-dsi-on-command = [39 01 00 00 00 00 06 ff ff 98 07 00 01 15 01 00 00 00 00 02 31 00 15 01 00 00 00 00 02 40 56 15 01 00 00 00 00 02 41 33 15 01 00 00 00 00 02 43 89 15 01 00 00 00 00 02 44 86 15 01 00 00 00 00 02 46 de 15 01 00 00 00 00 02 50 98 15 01 00 00 00 00 02 51 98 15 01 00 00 00 00 02 60 05 15 01 00 00 00 00 02 61 00 15 01 00 00 00 00 02 62 0a 15 01 00 00 00 00 02 63 00 39 01 00 00 00 00 06 ff ff 98 07 00 01 15 01 00 00 00 00 02 a0 00 15 01 00 00 00 00 02 a1 0e 15 01 00 00 00 00 02 a2 18 15 01 00 00 00 00 02 a3 0d 15 01 00 00 00 00 02 a4 06 15 01 00 00 00 00 02 a5 0b 15 01 00 00 00 00 02 a6 07 15 01 00 00 00 00 02 a7 03 15 01 00 00 00 00 02 a8 07 15 01 00 00 00 00 02 a9 0c 15 01 00 00 00 00 02 aa 11 15 01 00 00 00 00 02 ab 08 15 01 00 00 00 00 02 ac 0e 15 01 00 00 00 00 02 ad 13 15 01 00 00 00 00 02 ae 0b 15 01 00 00 00 00 02 af 00 15 01 00 00 00 00 02 c0 00 15 01 00 00 00 00 02 c1 0e 15 01 00 00 00 00 02 c2 17 15 01 00 00 00 00 02 c3 0d 15 01 00 00 00 00 02 c4 05 15 01 00 00 00 00 02 c5 0a 15 01 00 00 00 00 02 c6 06 15 01 00 00 00 00 02 c7 04 15 01 00 00 00 00 02 c8 08 15 01 00 00 00 00 02 c9 0c 15 01 00 00 00 00 02 ca 11 15 01 00 00 00 00 02 cb 08 15 01 00 00 00 00 02 cc 0f 15 01 00 00 00 00 02 cd 13 15 01 00 00 00 00 02 ce 0b 15 01 00 00 00 00 02 cf 00 39 01 00 00 00 00 06 ff ff 98 07 00 06 15 01 00 00 00 00 02 00 21 15 01 00 00 00 00 02 01 04 15 01 00 00 00 00 02 02 00 15 01 00 00 00 00 02 03 01 15 01 00 00 00 00 02 04 01 15 01 00 00 00 00 02 05 26 15 01 00 00 00 00 02 06 80 15 01 00 00 00 00 02 07 02 15 01 00 00 00 00 02 08 05 15 01 00 00 00 00 02 09 90 15 01 00 00 00 00 02 0a 02 15 01 00 00 00 00 02 0b 00 15 01 00 00 00 00 02 0c 13 15 01 00 00 00 00 02 0d 13 15 01 00 00 00 00 02 0e 00 15 01 00 00 00 00 02 0f 00 15 01 00 00 00 00 02 10 77 15 01 00 00 00 00 02 11 f0 15 01 00 00 00 00 02 12 00 15 01 00 00 00 00 02 13 84 15 01 00 00 00 00 02 14 84 15 01 00 00 00 00 02 15 c0 15 01 00 00 00 00 02 16 08 15 01 00 00 00 00 02 17 00 15 01 00 00 00 00 02 18 00 15 01 00 00 00 00 02 19 00 15 01 00 00 00 00 02 1a 00 15 01 00 00 00 00 02 1b 00 15 01 00 00 00 00 02 1c 00 15 01 00 00 00 00 02 1d 00 15 01 00 00 00 00 02 20 01 15 01 00 00 00 00 02 21 23 15 01 00 00 00 00 02 22 45 15 01 00 00 00 00 02 23 67 15 01 00 00 00 00 02 24 01 15 01 00 00 00 00 02 25 23 15 01 00 00 00 00 02 26 45 15 01 00 00 00 00 02 27 67 15 01 00 00 00 00 02 30 01 15 01 00 00 00 00 02 31 22 15 01 00 00 00 00 02 32 22 15 01 00 00 00 00 02 33 11 15 01 00 00 00 00 02 34 00 15 01 00 00 00 00 02 35 86 15 01 00 00 00 00 02 36 68 15 01 00 00 00 00 02 37 22 15 01 00 00 00 00 02 38 22 15 01 00 00 00 00 02 39 da 15 01 00 00 00 00 02 3a bc 15 01 00 00 00 00 02 3b cb 15 01 00 00 00 00 02 3c ad 15 01 00 00 00 00 02 3d 22 15 01 00 00 00 00 02 3e 22 15 01 00 00 00 00 02 3f 22 15 01 00 00 00 00 02 40 22 15 01 00 00 00 00 02 41 22 15 01 00 00 00 00 02 42 22 15 01 00 00 00 00 02 43 22 39 01 00 00 00 00 06 ff ff 98 07 00 07 15 01 00 00 00 00 02 02 77 39 01 00 00 00 00 06 ff ff 98 07 00 00 15 01 00 00 00 00 02 55 01 15 01 00 00 00 00 02 53 24 15 01 00 00 00 00 02 51 ff 05 01 00 00 78 00 02 11 00 39 01 00 00 00 00 06 ff ff 98 07 00 05 15 01 00 00 00 00 02 04 02 15 01 00 00 00 00 02 1a 14 15 01 00 00 00 00 02 25 07 15 01 00 00 00 00 02 26 07 15 01 00 00 00 00 02 27 07 15 01 00 00 00 00 02 28 07 15 01 00 00 00 00 02 29 07 15 01 00 00 00 00 02 2a 07 15 01 00 00 00 00 02 2b 07 15 01 00 00 00 00 02 2c 07 15 01 00 00 00 00 02 2d 07 15 01 00 00 00 00 02 2e 07 15 01 00 00 00 00 02 2f 07 15 01 00 00 00 00 02 30 08 15 01 00 00 00 00 02 31 08 15 01 00 00 00 00 02 32 07 15 01 00 00 00 00 02 33 07 15 01 00 00 00 00 02 34 07 15 01 00 00 00 00 02 35 07 15 01 00 00 00 00 02 36 07 15 01 00 00 00 00 02 37 07 15 01 00 00 00 00 02 38 07 15 01 00 00 00 00 02 39 06 15 01 00 00 00 00 02 3a 05 15 01 00 00 00 00 02 3b 06 15 01 00 00 00 00 02 3c 06 39 01 00 00 00 00 06 ff ff 98 07 00 02 15 01 00 00 00 00 02 00 00 15 01 00 00 00 00 02 01 00 15 01 00 00 00 00 02 02 00 15 01 00 00 00 00 02 03 00 15 01 00 00 00 00 02 04 00 15 01 00 00 00 00 02 05 00 15 01 00 00 00 00 02 06 00 15 01 00 00 00 00 02 07 00 15 01 00 00 00 00 02 08 00 15 01 00 00 00 00 02 09 00 15 01 00 00 00 00 02 0a 00 15 01 00 00 00 00 02 0b 00 15 01 00 00 00 00 02 0c 00 15 01 00 00 00 00 02 0d 00 15 01 00 00 00 00 02 0e 00 15 01 00 00 00 00 02 0f 00 15 01 00 00 00 00 02 10 00 15 01 00 00 00 00 02 11 00 15 01 00 00 00 00 02 12 00 15 01 00 00 00 00 02 13 00 15 01 00 00 00 00 02 14 00 15 01 00 00 00 00 02 15 10 15 01 00 00 00 00 02 16 10 15 01 00 00 00 00 02 17 10 15 01 00 00 00 00 02 18 10 15 01 00 00 00 00 02 19 20 15 01 00 00 00 00 02 1a 20 15 01 00 00 00 00 02 1b 30 15 01 00 00 00 00 02 1c 30 15 01 00 00 00 00 02 1d 40 15 01 00 00 00 00 02 1e 40 15 01 00 00 00 00 02 1f 50 15 01 00 00 00 00 02 20 50 15 01 00 00 00 00 02 21 60 15 01 00 00 00 00 02 22 60 15 01 00 00 00 00 02 23 70 15 01 00 00 00 00 02 24 70 15 01 00 00 00 00 02 25 70 15 01 00 00 00 00 02 26 70 15 01 00 00 00 00 02 27 70 15 01 00 00 00 00 02 28 70 15 01 00 00 00 00 02 29 70 15 01 00 00 00 00 02 2a 70 15 01 00 00 00 00 02 2b 70 15 01 00 00 00 00 02 2c 70 15 01 00 00 00 00 02 2d 70 15 01 00 00 00 00 02 2e 70 15 01 00 00 00 00 02 2f 70 15 01 00 00 00 00 02 30 70 15 01 00 00 00 00 02 31 70 15 01 00 00 00 00 02 32 70 15 01 00 00 00 00 02 33 70 15 01 00 00 00 00 02 34 70 15 01 00 00 00 00 02 35 70 15 01 00 00 00 00 02 36 70 15 01 00 00 00 00 02 37 70 15 01 00 00 00 00 02 38 70 15 01 00 00 00 00 02 39 60 15 01 00 00 00 00 02 3a 50 15 01 00 00 00 00 02 3b 40 15 01 00 00 00 00 02 3c 30 15 01 00 00 00 00 02 3d 20 15 01 00 00 00 00 02 3e 10 15 01 00 00 00 00 02 3f 00 15 01 00 00 00 00 02 40 03 39 01 00 00 00 00 06 ff ff 98 07 00 03 15 01 00 00 00 00 02 00 f0 15 01 00 00 00 00 02 01 f0 15 01 00 00 00 00 02 02 f0 15 01 00 00 00 00 02 03 f0 15 01 00 00 00 00 02 04 f0 15 01 00 00 00 00 02 05 f0 15 01 00 00 00 00 02 06 f0 15 01 00 00 00 00 02 07 f0 15 01 00 00 00 00 02 08 f0 15 01 00 00 00 00 02 09 f0 15 01 00 00 00 00 02 0a f0 15 01 00 00 00 00 02 0b f0 15 01 00 00 00 00 02 0c f0 15 01 00 00 00 00 02 0d f0 15 01 00 00 00 00 02 0e f0 15 01 00 00 00 00 02 0f f0 15 01 00 00 00 00 02 10 f0 15 01 00 00 00 00 02 11 f0 15 01 00 00 00 00 02 12 f0 15 01 00 00 00 00 02 13 f0 15 01 00 00 00 00 02 14 f0 15 01 00 00 00 00 02 15 f0 15 01 00 00 00 00 02 16 f0 15 01 00 00 00 00 02 17 f0 15 01 00 00 00 00 02 18 f0 15 01 00 00 00 00 02 19 f0 15 01 00 00 00 00 02 1a f0 15 01 00 00 00 00 02 1b f0 15 01 00 00 00 00 02 1c f0 15 01 00 00 00 00 02 1d f0 15 01 00 00 00 00 02 1e f0 15 01 00 00 00 00 02 1f f0 15 01 00 00 00 00 02 20 f0 15 01 00 00 00 00 02 21 f0 15 01 00 00 00 00 02 22 f0 15 01 00 00 00 00 02 23 f0 15 01 00 00 00 00 02 24 f0 15 01 00 00 00 00 02 25 f0 15 01 00 00 00 00 02 26 f0 15 01 00 00 00 00 02 27 f0 15 01 00 00 00 00 02 28 f0 15 01 00 00 00 00 02 29 f0 15 01 00 00 00 00 02 2a f0 15 01 00 00 00 00 02 2b f0 15 01 00 00 00 00 02 2c f0 15 01 00 00 00 00 02 2d f0 15 01 00 00 00 00 02 2e f0 15 01 00 00 00 00 02 2f f0 15 01 00 00 00 00 02 30 f0 15 01 00 00 00 00 02 31 f0 15 01 00 00 00 00 02 32 f0 15 01 00 00 00 00 02 33 f0 15 01 00 00 00 00 02 34 f0 15 01 00 00 00 00 02 35 f0 15 01 00 00 00 00 02 36 f0 15 01 00 00 00 00 02 37 f0 15 01 00 00 00 00 02 38 f0 15 01 00 00 00 00 02 39 f0 15 01 00 00 00 00 02 3a f0 15 01 00 00 00 00 02 3b f0 15 01 00 00 00 00 02 3c f0 15 01 00 00 00 00 02 3d f0 15 01 00 00 00 00 02 3e f0 15 01 00 00 00 00 02 3f f0 15 01 00 00 00 00 02 40 f0 15 01 00 00 00 00 02 41 f0 15 01 00 00 00 00 02 42 f0 15 01 00 00 00 00 02 43 f0 15 01 00 00 00 00 02 44 f0 15 01 00 00 00 00 02 45 f0 15 01 00 00 00 00 02 46 f0 15 01 00 00 00 00 02 47 f0 15 01 00 00 00 00 02 48 f0 15 01 00 00 00 00 02 49 f0 15 01 00 00 00 00 02 4a f0 15 01 00 00 00 00 02 4b f0 15 01 00 00 00 00 02 4c f0 15 01 00 00 00 00 02 4d f0 15 01 00 00 00 00 02 4e f0 15 01 00 00 00 00 02 4f f0 15 01 00 00 00 00 02 50 f0 15 01 00 00 00 00 02 51 f0 15 01 00 00 00 00 02 52 f0 15 01 00 00 00 00 02 53 f0 15 01 00 00 00 00 02 54 70 15 01 00 00 00 00 02 55 90 15 01 00 00 00 00 02 56 b0 15 01 00 00 00 00 02 57 a0 15 01 00 00 00 00 02 58 a0 15 01 00 00 00 00 02 59 b0 15 01 00 00 00 00 02 5a c0 15 01 00 00 00 00 02 5b d0 15 01 00 00 00 00 02 5c f0 15 01 00 00 00 00 02 5d f0 15 01 00 00 00 00 02 5e f0 15 01 00 00 00 00 02 5f f0 15 01 00 00 00 00 02 60 f0 15 01 00 00 00 00 02 61 f0 15 01 00 00 00 00 02 62 f0 15 01 00 00 00 00 02 63 f0 15 01 00 00 00 00 02 64 70 15 01 00 00 00 00 02 65 90 15 01 00 00 00 00 02 66 b0 15 01 00 00 00 00 02 67 a0 15 01 00 00 00 00 02 68 a0 15 01 00 00 00 00 02 69 b0 15 01 00 00 00 00 02 6a c0 15 01 00 00 00 00 02 6b d0 15 01 00 00 00 00 02 6c 70 15 01 00 00 00 00 02 6d 90 15 01 00 00 00 00 02 6e b0 15 01 00 00 00 00 02 6f a0 15 01 00 00 00 00 02 70 a0 15 01 00 00 00 00 02 71 b0 15 01 00 00 00 00 02 72 c0 15 01 00 00 00 00 02 73 d0 15 01 00 00 00 00 02 74 70 15 01 00 00 00 00 02 75 90 15 01 00 00 00 00 02 76 b0 15 01 00 00 00 00 02 77 a0 15 01 00 00 00 00 02 78 a0 15 01 00 00 00 00 02 79 b0 15 01 00 00 00 00 02 7a c0 15 01 00 00 00 00 02 7b d0 15 01 00 00 00 00 02 7c 70 15 01 00 00 00 00 02 7d 90 15 01 00 00 00 00 02 7e b0 15 01 00 00 00 00 02 7f a0 39 01 00 00 00 00 06 ff ff 98 07 00 04 15 01 00 00 00 00 02 00 a0 15 01 00 00 00 00 02 01 b0 15 01 00 00 00 00 02 02 c0 15 01 00 00 00 00 02 03 d0 15 01 00 00 00 00 02 04 70 15 01 00 00 00 00 02 05 90 15 01 00 00 00 00 02 06 b0 15 01 00 00 00 00 02 07 a0 15 01 00 00 00 00 02 08 a0 15 01 00 00 00 00 02 09 b0 15 01 00 00 00 00 02 0a c0 15 01 00 00 00 00 02 0b d0 15 01 00 00 00 00 02 0c 70 15 01 00 00 00 00 02 0d 90 15 01 00 00 00 00 02 0e b0 15 01 00 00 00 00 02 0f a0 15 01 00 00 00 00 02 10 a0 15 01 00 00 00 00 02 11 b0 15 01 00 00 00 00 02 12 c0 15 01 00 00 00 00 02 13 d0 15 01 00 00 00 00 02 14 f0 15 01 00 00 00 00 02 15 f0 15 01 00 00 00 00 02 16 f0 15 01 00 00 00 00 02 17 f0 15 01 00 00 00 00 02 18 f0 15 01 00 00 00 00 02 19 f0 15 01 00 00 00 00 02 1a f0 15 01 00 00 00 00 02 1b f0 15 01 00 00 00 00 02 1c f0 15 01 00 00 00 00 02 1d f0 15 01 00 00 00 00 02 1e f0 15 01 00 00 00 00 02 1f f0 15 01 00 00 00 00 02 20 f0 15 01 00 00 00 00 02 21 f0 15 01 00 00 00 00 02 22 f0 15 01 00 00 00 00 02 23 f0 15 01 00 00 00 00 02 24 f0 15 01 00 00 00 00 02 25 f0 15 01 00 00 00 00 02 26 f0 15 01 00 00 00 00 02 27 f0 15 01 00 00 00 00 02 28 f0 15 01 00 00 00 00 02 29 f0 15 01 00 00 00 00 02 2a f0 15 01 00 00 00 00 02 2b f0 15 01 00 00 00 00 02 2c f0 15 01 00 00 00 00 02 2d f0 15 01 00 00 00 00 02 2e f0 15 01 00 00 00 00 02 2f f0 15 01 00 00 00 00 02 30 f0 15 01 00 00 00 00 02 31 f0 15 01 00 00 00 00 02 32 f0 15 01 00 00 00 00 02 33 f0 15 01 00 00 00 00 02 34 f0 15 01 00 00 00 00 02 35 f0 15 01 00 00 00 00 02 36 f0 15 01 00 00 00 00 02 37 f0 15 01 00 00 00 00 02 38 f0 15 01 00 00 00 00 02 39 f0 15 01 00 00 00 00 02 3a f0 15 01 00 00 00 00 02 3b f0 15 01 00 00 00 00 02 3c f0 15 01 00 00 00 00 02 3d f0 15 01 00 00 00 00 02 3e f0 15 01 00 00 00 00 02 3f f0 15 01 00 00 00 00 02 40 f0 15 01 00 00 00 00 02 41 f0 15 01 00 00 00 00 02 42 f0 15 01 00 00 00 00 02 43 f0 15 01 00 00 00 00 02 44 f0 15 01 00 00 00 00 02 45 f0 15 01 00 00 00 00 02 46 f0 15 01 00 00 00 00 02 47 f0 15 01 00 00 00 00 02 48 f0 15 01 00 00 00 00 02 49 f0 15 01 00 00 00 00 02 4a f0 15 01 00 00 00 00 02 4b f0 15 01 00 00 00 00 02 4c f0 15 01 00 00 00 00 02 4d f0 15 01 00 00 00 00 02 4e f0 15 01 00 00 00 00 02 4f f0 15 01 00 00 00 00 02 50 f0 15 01 00 00 00 00 02 51 f0 15 01 00 00 00 00 02 52 f0 15 01 00 00 00 00 02 53 f0 15 01 00 00 00 00 02 54 f0 15 01 00 00 00 00 02 55 f0 15 01 00 00 00 00 02 56 d0 15 01 00 00 00 00 02 57 c0 15 01 00 00 00 00 02 58 a0 15 01 00 00 00 00 02 59 a0 15 01 00 00 00 00 02 5a a0 15 01 00 00 00 00 02 5b 80 15 01 00 00 00 00 02 5c 80 15 01 00 00 00 00 02 5d 40 15 01 00 00 00 00 02 5e 40 15 01 00 00 00 00 02 5f 40 15 01 00 00 00 00 02 60 f0 15 01 00 00 00 00 02 61 f0 15 01 00 00 00 00 02 62 f0 15 01 00 00 00 00 02 63 f0 15 01 00 00 00 00 02 64 d0 15 01 00 00 00 00 02 65 a0 15 01 00 00 00 00 02 66 70 15 01 00 00 00 00 02 67 40 15 01 00 00 00 00 02 68 50 15 01 00 00 00 00 02 69 30 15 01 00 00 00 00 02 6a 20 15 01 00 00 00 00 02 6b 00 15 01 00 00 00 00 02 6c 60 15 01 00 00 00 00 02 6d 50 15 01 00 00 00 00 02 6e 50 15 01 00 00 00 00 02 6f 50 15 01 00 00 00 00 02 70 e0 15 01 00 00 00 00 02 71 c0 15 01 00 00 00 00 02 72 a0 15 01 00 00 00 00 02 73 80 15 01 00 00 00 00 02 74 60 15 01 00 00 00 00 02 75 40 15 01 00 00 00 00 02 76 20 15 01 00 00 00 00 02 77 00 15 01 00 00 00 00 02 78 00 15 01 00 00 00 00 02 79 10 15 01 00 00 00 00 02 7a 30 15 01 00 00 00 00 02 7b 30 15 01 00 00 00 00 02 7c 10 15 01 00 00 00 00 02 7d 10 15 01 00 00 00 00 02 7e 10 15 01 00 00 00 00 02 7f 00 39 01 00 00 00 00 06 ff ff 98 07 00 01 15 01 00 00 00 00 02 56 01 15 01 00 00 00 00 02 53 78 39 01 00 00 00 00 06 ff ff 98 07 00 00 05 01 00 00 14 00 02 29 00];
		qcom,mdss-dsi-off-command = [05 01 00 00 23 00 02 28 00 05 01 00 00 78 00 02 10 00];
		qcom,mdss-dsi-on-command-state = "dsi_lp_mode";
		qcom,mdss-dsi-off-command-state = "dsi_hs_mode";
		qcom,mdss-dsi-h-sync-pulse = <0x01>;
		qcom,mdss-dsi-traffic-mode = "burst_mode";
		qcom,mdss-dsi-lane-map = "lane_map_0123";
		qcom,mdss-dsi-bllp-eof-power-mode;
		qcom,mdss-dsi-bllp-power-mode;
		qcom,mdss-dsi-lane-0-state;
		qcom,mdss-dsi-lane-1-state;
		qcom,mdss-dsi-panel-timings = <0x871e1400 0x444b1921 0x22030400>;
		qcom,mdss-dsi-t-clk-post = <0x03>;
		qcom,mdss-dsi-t-clk-pre = <0x13>;
		qcom,mdss-dsi-bl-min-level = <0x1e>;
		qcom,mdss-dsi-bl-max-level = <0xff>;
		qcom,mdss-dsi-dma-trigger = "trigger_sw";
		qcom,mdss-dsi-mdp-trigger = "none";
		qcom,mdss-dsi-bl-pmic-control-type = "bl_ctrl_wled";
		qcom,mdss-dsi-default-command-state = "dsi_hs_mode";
		qcom,mdss-pan-physical-width-dimension = <0x3a>;
		qcom,mdss-pan-physical-height-dimension = <0x67>;

		qcom,mdss-dsi-reset-sequence = <1 20>, <0 1>, <1 20>;
		qcom,panel-supply-entries = <&dsi_panel_pwr_supply>;
		};
};
