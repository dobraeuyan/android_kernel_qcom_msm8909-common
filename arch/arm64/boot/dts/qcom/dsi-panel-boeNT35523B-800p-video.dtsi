/* Copyright (c) 2014-2015, 2020, The Linux Foundation. All rights reserved.
 *
 * This program is free software; you can redistribute it and/or modify
 * it under the terms of the GNU General Public License version 2 and
 * only version 2 as published by the Free Software Foundation.
 *
 * This program is distributed in the hope that it will be useful,
 * but WITHOUT ANY WARRANTY; without even the implied warranty of
 * MERCHANTABILITY or FITNESS FOR A PARTICULAR PURPOSE.  See the
 * GNU General Public License for more details.
 */

&mdss_mdp {
	dsi_boent35523b_800p_vid: qcom,mdss_dsi_boent35523b_800p_video {
		qcom,mdss-dsi-panel-name = "boeNT35523B 800p video mode dsi panel";
		qcom,mdss-dsi-panel-controller = <&mdss_dsi0>;
		qcom,mdss-dsi-panel-type = "dsi_video_mode";
		qcom,mdss-dsi-panel-destination = "display_1";
		qcom,mdss-dsi-panel-framerate = <60>;
		qcom,mdss-dsi-virtual-channel-id = <0>;
		qcom,mdss-dsi-stream = <0>;
		qcom,mdss-dsi-panel-width = <800>;
		qcom,mdss-dsi-panel-height = <1280>;
		qcom,mdss-dsi-h-front-porch = <50>;
		qcom,mdss-dsi-h-back-porch = <48>;
		qcom,mdss-dsi-h-pulse-width = <16>;
		qcom,mdss-dsi-h-sync-skew = <0>;
		qcom,mdss-dsi-v-back-porch = <12>;
		qcom,mdss-dsi-v-front-porch = <20>;
		qcom,mdss-dsi-v-pulse-width = <4>;
		qcom,mdss-dsi-h-left-border = <0>;
		qcom,mdss-dsi-h-right-border = <0>;
		qcom,mdss-dsi-v-top-border = <0>;
		qcom,mdss-dsi-v-bottom-border = <0>;
		qcom,mdss-dsi-bpp = <24>;
		qcom,mdss-dsi-underflow-color = <0xff>;
		qcom,mdss-dsi-border-color = <0>;
		qcom,mdss-dsi-on-command = [
			39 01 00 00 00 00 06 f0 55 aa 52 08 00
			39 01 00 00 00 00 02 b2 25
			39 01 00 00 00 00 03 bb 63 63
			39 01 00 00 00 00 03 bc 0f 00
			39 01 00 00 00 00 05 bd 01 40 0d 06
			39 01 00 00 00 00 06 f0 55 aa 52 08 01
			39 01 00 00 00 00 02 b3 28
			39 01 00 00 00 00 02 b4 14
			39 01 00 00 00 00 02 b9 45
			39 01 00 00 00 00 02 ba 25
			39 01 00 00 00 00 03 bc 78 00
			39 01 00 00 00 00 03 bd 78 00
			39 01 00 00 00 00 02 ca 02
			39 01 00 00 00 00 02 ce 04
			39 01 00 00 00 00 06 f0 55 aa 52 08 02
			39 01 00 00 00 00 02 b0 82
			39 01 00 00 00 00 11 d1 00 00 00 06 00 28 00 4a 00 63 00 8d 00 b0 00 e5
			39 01 00 00 00 00 11 d2 01 0f 01 50 01 83 01 ce 02 0b 02 0c 02 43 02 7d
			39 01 00 00 00 00 11 d3 02 a0 02 d3 02 f5 03 24 03 43 03 6c 03 86 03 a1
			39 01 00 00 00 00 05 d4 03 ba 03 ff
			39 01 00 00 00 00 11 e0 00 00 00 2a 00 54 00 6a 00 83 00 a7 00 c2 00 f1
			39 01 00 00 00 00 11 e1 01 17 01 56 01 87 01 d0 02 0b 02 0c 02 43 02 7d
			39 01 00 00 00 00 11 e2 02 a2 02 d5 02 f7 03 28 03 43 03 6c 03 86 03 a1
			39 01 00 00 00 00 05 e3 03 ba 03 ff
			39 01 00 00 00 00 06 f0 55 aa 52 08 03
			39 01 00 00 00 00 05 b0 00 00 00 00
			39 01 00 00 00 00 05 b1 00 00 00 00
			39 01 00 00 00 00 08 b2 01 00 09 03 00 34 48
			39 01 00 00 00 00 08 b3 01 00 08 03 00 34 48
			39 01 00 00 00 00 0b b6 f0 05 04 05 00 00 00 00 34 48
			39 01 00 00 00 00 0b b7 f0 05 04 05 00 00 00 00 34 48
			39 01 00 00 00 00 08 ba 84 04 00 07 01 34 48
			39 01 00 00 00 00 08 bb 84 04 00 06 01 34 48
			39 01 00 00 00 00 03 c4 10 00
			39 01 00 00 00 00 03 c5 00 00
			39 01 00 00 00 00 06 f0 55 aa 52 08 05
			39 01 00 00 00 00 05 b0 33 03 00 03
			39 01 00 00 00 00 03 b1 30 00
			39 01 00 00 00 00 04 b2 03 01 00
			39 01 00 00 00 00 05 b3 82 00 81 38
			39 01 00 00 00 00 05 b4 d5 75 07 57
			39 01 00 00 00 00 07 b6 01 00 d5 71 07 57
			39 01 00 00 00 00 06 b9 09 00 00 05 00
			39 01 00 00 00 00 06 c0 75 07 00 57 05
			39 01 00 00 00 00 02 c6 20
			39 01 00 00 00 00 06 d0 00 25 01 00 00
			39 01 00 00 00 00 06 d1 00 25 02 00 00
			39 01 00 00 00 00 06 f0 55 aa 52 08 06
			39 01 00 00 00 00 06 b0 32 32 02 02 03
			39 01 00 00 00 00 06 b1 03 33 33 08 3d
			39 01 00 00 00 00 06 b2 0a 0a 3d 17 17
			39 01 00 00 00 00 06 b3 16 16 19 19 18
			39 01 00 00 00 00 03 b4 18 33
			39 01 00 00 00 00 06 b5 32 32 00 00 01
			39 01 00 00 00 00 06 b6 01 33 33 08 3d
			39 01 00 00 00 00 06 b7 0a 0a 3d 11 11
			39 01 00 00 00 00 06 b8 10 10 13 13 12
			39 01 00 00 00 00 03 b9 12 33
			39 01 00 00 00 00 05 ff aa 55 a5 80
			39 01 00 00 00 00 02 6f 08
			39 01 00 00 00 00 02 fc 00
			39 01 00 00 00 00 02 6f 09
			39 01 00 00 00 00 02 f7 82
			39 01 00 00 00 00 02 6f 0b
			39 01 00 00 00 00 02 f7 e0
			39 01 00 00 00 00 05 ff aa 55 a5 00
			05 01 00 00 78 00 02 11 00
			05 01 00 00 0a 00 02 29 00];
		qcom,mdss-dsi-off-command = [
			05 01 00 00 14 00 02 28 00
			05 01 00 00 78 00 02 10 00];
		qcom,mdss-dsi-on-command-state = "dsi_lp_mode";
		qcom,mdss-dsi-off-command-state = "dsi_lp_mode";

		qcom,cont-splash-enabled;
		qcom,mdss-dsi-h-sync-pulse = <1>;
		qcom,mdss-dsi-traffic-mode = "burst_mode";
		qcom,mdss-dsi-bllp-eof-power-mode;
		qcom,mdss-dsi-bllp-power-mode;
		qcom,mdss-dsi-lane-0-state;
		qcom,mdss-dsi-lane-1-state;
		qcom,mdss-dsi-lane-2-state;
		qcom,mdss-dsi-lane-3-state;
		qcom,mdss-dsi-panel-timings = <0x7a1a1200 0x40421621 0x14030400>;
		qcom,mdss-dsi-t-clk-post = <0x04>;
		qcom,mdss-dsi-t-clk-pre = <0x1b>;
		qcom,mdss-dsi-bl-min-level = <1>;
		qcom,mdss-dsi-bl-max-level = <4095>;
		qcom,mdss-dsi-dma-trigger = "trigger_sw";
		qcom,mdss-dsi-mdp-trigger = "none";
		qcom,mdss-dsi-bl-pmic-control-type = "bl_ctrl_pwm";
		qcom,platform-bklight-en-gpio = <&msm_gpio 9 0>;
		qcom,mdss-dsi-lcden-ctrl = <&msm_gpio 24 0>;
		qcom,mdss-dsi-bl-pmic-pwm-frequency = <100>;
		qcom,mdss-dsi-bl-pmic-bank-select = <0>;
		qcom,mdss-dsi-pwm-gpio = <&pm8909_mpps 2 0>;
		qcom,mdss-dsi-reset-sequence = <1 20>, <0 10>, <1 120>;
		qcom,mdss-pan-physical-width-dimension = <135>;
		qcom,mdss-pan-physical-height-dimension = <216>;
	};
};
