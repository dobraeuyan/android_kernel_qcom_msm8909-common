## arch/arm/configs/lineage_a13_defconfig
```kconfig
CONFIG_BUILD_ARM_APPENDED_DTB_IMAGE_NAMES="qcom/msm8909-htc-a13"
CONFIG_HTC_WIFI_NVS=y
CONFIG_TOUCHSCREEN_HIMAX=y
CONFIG_INPUT_CAPELLA_CM36686=y
CONFIG_INPUT_ELAN_EPL88051=y
CONFIG_REGULATOR_NCP6924=y
CONFIG_OV8858_HTC=y
CONFIG_OV2680_HTC=y
CONFIG_LEDS_LM3697=y
CONFIG_LEDS_TPS61310_FLASHLIGHT=y
CONFIG_MSM_SYSMON_COMM=y
CONFIG_HTC_BDADDRESS=y
CONFIG_HTC_REBOOT_BLOCK=y
CONFIG_HTC_RADIO_SMEM=y
```

## arch/arm/configs/lineage_mimbre_defconfig
```kconfig
CONFIG_BUILD_ARM_APPENDED_DTB_IMAGE_NAMES="qcom/msm8909-mimbre"
CONFIG_TOUCHSCREEN_HIDEEP=y
CONFIG_INPUT_KIONIX_ACCEL=y
CONFIG_INPUT_HALL_OCH175=y
CONFIG_INPUT_SWITCH_CAMERA=y
CONFIG_SENSORS_AKM09911=y
CONFIG_SENSORS_ST480=y
CONFIG_SENSORS_EPL2102=y
CONFIG_BATTERY_BQ27XXX=y
CONFIG_BATTERY_BQ27XXX_I2C=y
CONFIG_TS3A225E=y
CONFIG_LEDS_SN3191=y
CONFIG_LEDS_TRIGGER_TIMER=y
```

## arch/arm/configs/lineage_msm8909_debug_defconfig
```kconfig
CONFIG_KALLSYMS_ALL=y
CONFIG_OPROFILE=m
CONFIG_PM_DEBUG=y
CONFIG_PM_SLEEP_DEBUG=y
CONFIG_BT_DEBUGFS=y
CONFIG_EARLY_PRINTK=y
CONFIG_USB_GADGET_DEBUG_FILES=y
CONFIG_USB_GADGET_DEBUG_FS=y
CONFIG_MMC_PERF_PROFILING=y
CONFIG_TRACER_PKT=y
CONFIG_SCHED_DEBUG=y
CONFIG_SCHEDSTATS=y
CONFIG_DEBUG_PREEMPT=y
CONFIG_FAULT_INJECTION=y
CONFIG_FAIL_PAGE_ALLOC=y
CONFIG_CPU_FREQ_SWITCH_PROFILER=y
CONFIG_LKDTM=y
CONFIG_MEMTEST=y
CONFIG_MEMTEST_ENABLE_DEFAULT=0
CONFIG_CORESIGHT=y
```

## arch/arm/configs/lineage_x103f_defconfig
```kconfig
CONFIG_BUILD_ARM_APPENDED_DTB_IMAGE_NAMES="qcom/msm8909-lenovo-x103f"
CONFIG_TOUCHSCREEN_SYNAPTICS_DSX=y
CONFIG_TOUCHSCREEN_SYNAPTICS_DSX_I2C=y
CONFIG_TOUCHSCREEN_SYNAPTICS_DSX_CORE=y
CONFIG_TOUCHSCREEN_SYNAPTICS_DSX_RMI_DEV=y
CONFIG_TOUCHSCREEN_SYNAPTICS_DSX_FW_UPDATE=y
CONFIG_TOUCHSCREEN_GT9110=y
CONFIG_GT9XX_TOUCHPANEL_DRIVER=y
CONFIG_GT9XX_TOUCHPANEL_UPDATE=y
CONFIG_TOUCHSCREEN_FT5X36=y
CONFIG_INPUT_KIONIX_ACCEL=y
CONFIG_BATTERY_BQ27XXX=y
CONFIG_BATTERY_BQ27XXX_I2C=y
```

## arch/arm/configs/lineage_x104f1_defconfig
```kconfig
CONFIG_BUILD_ARM_APPENDED_DTB_IMAGE_NAMES="qcom/msm8909-lenovo-x104f1"
CONFIG_TOUCHSCREEN_GT9110=y
CONFIG_GT9XX_TOUCHPANEL_DRIVER=y
CONFIG_GT9XX_TOUCHPANEL_UPDATE=y
CONFIG_TOUCHSCREEN_GSLX68X=y
```

## arch/arm/configs/lineage_x104f_defconfig
```kconfig
CONFIG_BUILD_ARM_APPENDED_DTB_IMAGE_NAMES="qcom/apq8009-lenovo-x104f"
CONFIG_TOUCHSCREEN_GT9110=y
CONFIG_GT9XX_TOUCHPANEL_DRIVER=y
CONFIG_GT9XX_TOUCHPANEL_UPDATE=y
CONFIG_TOUCHSCREEN_GSLX68X=y
```

## drivers/htc_ril/Kconfig
```kconfig
config HTC_RADIO_SMEM
	bool "HTC radio shared memory (AP run-mode handshake)"
	depends on OF
	default n
	help
	  Writes a 1 KiB structure to a fixed region in DRAM. The MPSS on
	  HTC devices reads this at boot to determine the execution state
	  of the Application Processor (bootloader, FTM, recovery, or HLOS).

	  Without this, the modem boots in a restricted mode. While RF and
	  SIM remain functional, it does not expose the QMUX control SMD
	  channels (DATA5_CNTL/DATA40_CNTL), causing qmuxd to fail with
	  -ENODEV and breaking telephony.

	  Required for the HTC Desire 530 (a16).
```

## drivers/input/touchscreen/ft5x36/Kconfig
```kconfig
config TOUCHSCREEN_FT5X36
	bool "FocalTech FT5x36 / FT5626 touchscreen"
	depends on I2C
	help
	  Say Y here to enable support for the FocalTech FT5x36 family
	  (specifically the FT5626, chip id 0x56) as shipped on some
	  Lenovo TB-X103F batches.

	  If unsure, say N.
```

## drivers/input/touchscreen/gslx68x/Kconfig
```kconfig
config TOUCHSCREEN_GSLX68X
	bool "Silead GSLx68x (gsl-tp) capacitive touchscreen"
	depends on I2C
	help
	  Say Y here to enable support for the Silead GSLx68x family
	  capacitive touch controller

	  If unsure, say N.
```

## drivers/input/touchscreen/himax_852xD/Kconfig
```kconfig
config TOUCHSCREEN_HIMAX
	bool "Himax HX852xD touchscreen"
	depends on I2C
	help
	  Say Y here to enable support for the Himax HX852xD touch controller
	  as wired on the HTC Desire 526 Verizon

	  If unsure, say N.
```

## drivers/input/touchscreen/himax_852xes/Kconfig
```kconfig
#
# Himax HX852xES touchscreen driver (HTC a16 / Desire 530)
#

config TOUCHSCREEN_HIMAX_852XES
	bool "Himax HX852xES touchscreen"
	depends on I2C
	help
	  Say Y here to enable support for the Himax HX852xES touch controller.

	  If unsure, say N.

config TOUCHSCREEN_HIMAX_852XES_DEBUG
	bool "Himax HX852xES debug/diag nodes"
	depends on TOUCHSCREEN_HIMAX_852XES
	help
	  Enables /sys/android_touch sysfs nodes for diagnostics, registers,
	  debugging, flash dumps, self-tests, and hardware resets. This also
	  enables verbose logging for the driver.

config TOUCHSCREEN_HIMAX_852XES_ESD
	bool "Himax HX852xES ESD workaround"
	depends on TOUCHSCREEN_HIMAX_852XES
	help
	  Enables an Electrostatic Discharge (ESD) recovery routine. If the
	  touch controller stops responding due to an ESD event, this
	  workaround automatically restarts it via the hardware reset line.
```
